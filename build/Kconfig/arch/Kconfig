## build/Kconfig/arch/Kconfig
```kconfig
# Load Zephyr Arch Kconfig descriptions.
osource "/Users/andriasworld/zephyrproject/zephyr/arch/rx/Kconfig"
osource "/Users/andriasworld/zephyrproject/zephyr/arch/x86/Kconfig"
osource "/Users/andriasworld/zephyrproject/zephyr/arch/xtensa/Kconfig"
osource "/Users/andriasworld/zephyrproject/zephyr/arch/sparc/Kconfig"
osource "/Users/andriasworld/zephyrproject/zephyr/arch/riscv/Kconfig"
osource "/Users/andriasworld/zephyrproject/zephyr/arch/posix/Kconfig"
osource "/Users/andriasworld/zephyrproject/zephyr/arch/mips/Kconfig"
osource "/Users/andriasworld/zephyrproject/zephyr/arch/arm64/Kconfig"
osource "/Users/andriasworld/zephyrproject/zephyr/arch/arm/Kconfig"
osource "/Users/andriasworld/zephyrproject/zephyr/arch/arc/Kconfig"
```

## build/Kconfig/boards/Kconfig
```kconfig
# Load Zephyr board Kconfig descriptions.
osource "/Users/andriasworld/zephyrproject/zephyr/boards/st/nucleo_wl55jc/Kconfig"
```

## build/Kconfig/boards/Kconfig.defconfig
```kconfig
# Load Zephyr board defconfig descriptions.
osource "/Users/andriasworld/zephyrproject/zephyr/boards/st/nucleo_wl55jc/Kconfig.defconfig"
```

## build/Kconfig/boards/Kconfig.nucleo_wl55jc
```kconfig
# Load board Kconfig descriptions.
osource "/Users/andriasworld/zephyrproject/zephyr/boards/st/nucleo_wl55jc/Kconfig.nucleo_wl55jc"
```

## build/Kconfig/boards/Kconfig.sysbuild
```kconfig
# Load Sysbuild board Kconfig descriptions.
osource "/Users/andriasworld/zephyrproject/zephyr/boards/st/nucleo_wl55jc/Kconfig.sysbuild"
```
